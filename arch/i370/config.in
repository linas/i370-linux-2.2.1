## arch/i370/config.in
```kconfig
# For a description of the syntax of this configuration file,
# see the Configure script.
#
mainmenu_name "Linux ESA/390 Kernel Configuration"

mainmenu_option next_comment
comment 'Platform support'
define_bool CONFIG_I370 y
choice 'Processor type' \
	"390		CONFIG_390"  yo ho ho

choice 'Machine Type' \
	"ES390		CONFIG_ES390" ya ha ha

bool 'Symmetric multi-processing support' CONFIG_SMP
bool 'Checksum Facility Installed' CONFIG_CKSM

bool 'IBM 390 Virtual Machine environment' CONFIG_VM_GUEST
bool 'IBM 390 Hercules environment' CONFIG_HERCULES_GUEST
endmenu

mainmenu_option next_comment
comment 'General setup'

bool 'Prompt for development and/or incomplete code/drivers' CONFIG_EXPERIMENTAL
bool 'Enable loadable module support' CONFIG_MODULES
if [ "$CONFIG_MODULES" = "y" ]; then
  bool 'Set version information on all symbols for modules' CONFIG_MODVERSIONS
  bool 'Kernel module loader' CONFIG_KMOD
fi

bool 'Networking support' CONFIG_NET
bool 'Sysctl support' CONFIG_SYSCTL
bool 'System V IPC' CONFIG_SYSVIPC
bool 'BSD Process Accounting' CONFIG_BSD_PROCESS_ACCT

define_bool CONFIG_BINFMT_ELF y
define_bool CONFIG_KERNEL_ELF y
tristate 'Kernel support for a.out binaries' CONFIG_BINFMT_AOUT
tristate 'Kernel support for MISC binaries' CONFIG_BINFMT_MISC

bool 'Include kgdb kernel debugger' CONFIG_KGDB
bool 'Include xmon kernel debugger' CONFIG_XMON


bool 'String includes (experimental)'  CONFIG_STRING_INLINES
bool 'String feature (in processor)'   CONFIG_STRING_FEATURE
endmenu

# ====================================================================
#
# Block device driver configuration
#
mainmenu_option next_comment
comment 'Block devices'

tristate 'Loopback device support' CONFIG_BLK_DEV_LOOP
if [ "$CONFIG_NET" = "y" ]; then
  tristate 'Network block device support' CONFIG_BLK_DEV_NBD
fi
tristate 'RAM disk support' CONFIG_BLK_DEV_RAM
if [ "$CONFIG_BLK_DEV_RAM" = "y" ]; then
  bool '   Initial RAM disk (initrd) support' CONFIG_BLK_DEV_INITRD
fi

endmenu

# ====================================================================

if [ "$CONFIG_NET" = "y" ]; then
  source net/Config.in
fi

# ====================================================================
#
# Character device configuration
#
mainmenu_option next_comment
comment 'Character devices'

# Support the 3215/3270 as console
bool 'Standard 3210/3215/3270 console support' CONFIG_3270_CONSOLE

bool 'Unix98 PTY support' CONFIG_UNIX98_PTYS
if [ "$CONFIG_UNIX98_PTYS" = "y" ]; then
	int 'Maximum number of Unix98 PTYs in use (0-2048)' CONFIG_UNIX98_PTY_COUNT 256
fi
endmenu

# ====================================================================
source fs/Config.in

endmenu
```
